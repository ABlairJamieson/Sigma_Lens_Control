/dts-v1/;
/plugin/;

/ {
	fragment@0 {
		target-path = "/i2c@feca0000/es8316@11";
		__overlay__ {
			status = "disabled";
		};
	};

	fragment@1 {
		target-path = "/es8316-sound";
		__overlay__ {
			status = "disabled";
		};
	};
};
